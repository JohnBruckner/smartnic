## arch/x86/Kconfig.rej
```kconfig
--- arch/x86/Kconfig	2018-06-13 10:15:29.000000000 -0400
+++ arch/x86/Kconfig	2020-03-30 16:06:48.506736018 -0400
@@ -47,6 +47,7 @@ config X86
 	select ARCH_WANT_FRAME_POINTERS
 	select ARCH_WANT_IPC_PARSE_VERSION	if X86_32
 	select ARCH_WANT_OPTIONAL_GPIOLIB
+	select ARCH_SUPPORTS_POPCORN	if X86_64
 	select BUILDTIME_EXTABLE_SORT
 	select CLKEVT_I8253
 	select CLKSRC_I8253			if X86_32
@@ -294,6 +295,7 @@ config PGTABLE_LEVELS
 
 source "init/Kconfig"
 source "kernel/Kconfig.freezer"
+source "kernel/Kconfig.popcorn"
 
 menu "Processor type and features"
 
```
